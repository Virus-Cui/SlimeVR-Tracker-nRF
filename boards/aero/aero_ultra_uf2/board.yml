## boards/aero/aero_ultra_uf2/board.yml
```yaml
# Copyright (c) 2024 Nordic Semiconductor ASA
# SPDX-License-Identifier: Apache-2.0

board:
  name: aero_ultra_uf2
  full_name: AeroTrackerUltra
  vendor: aero
  socs:
    - name: nrf52840
```
